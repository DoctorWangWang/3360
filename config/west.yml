## config/west.yml
```yaml
manifest:
  remotes:
    - name: zmk
      url-base: https://github.com/DoctorWangWang
  projects:
    - name: zmk
      remote: zmkfirmware
      revision: ptdevice-alpotato
      import: app/west.yml
  self:
    path: config
```
